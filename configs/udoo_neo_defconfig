## configs/udoo_neo_defconfig
```kconfig
CONFIG_SPL=y
CONFIG_SYS_EXTRA_OPTIONS="IMX_CONFIG=arch/arm/imx-common/spl_sd.cfg,MX6SX,SYS_DCACHE_OFF=1,SYS_ICACHE_OFF=1"
CONFIG_ARM=y
CONFIG_TARGET_UDOO_NEO=y
CONFIG_DM=y
CONFIG_DM_THERMAL=y
```
